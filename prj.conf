## CMakeLists.txt
```
# SPDX-License-Identifier: Apache-2.0

cmake_minimum_required(VERSION 3.20.0)


find_package(Zephyr REQUIRED HINTS $ENV{ZEPHYR_BASE})
project(hello_world)

# add_subdirectory(decadriver)
include_directories(decadriver platform protocol inc ranging tty)

target_sources(app PRIVATE
    src/main.c
    src/uwb_threads.c
    src/uwb_transport.c
    src/uart.c
    src/ros.c
    src/statistics.c
    platform/deca_spi.c
    platform/deca_mutex.c
    platform/deca_sleep.c
    platform/platform.c
    decadriver/deca_device.c
    decadriver/deca_params_init.c
    ranging/ranging.cpp
    ranging/node.c
    protocol/mac.c
    tty/tty.c
    # baca/baca.c
)

set_property(TARGET app PROPERTY CXX_STANDARD 20)

# target_link_libraries(app PUBLIC decadriver)
```

## prj.conf
```kconfig
CONFIG_BOARD_DECAWAVE_DWM1001_DEV=y

CONFIG_REBOOT=y
CONFIG_TIMING_FUNCTIONS=y

CONFIG_TEST_RANDOM_GENERATOR=y
CONFIG_TIMER_RANDOM_GENERATOR=y

CONFIG_RING_BUFFER=y

CONFIG_SERIAL=y
CONFIG_UART_INTERRUPT_DRIVEN=y

CONFIG_UART_CONSOLE=n
CONFIG_RTT_CONSOLE=y
CONFIG_USE_SEGGER_RTT=y
# enable to use thread names
CONFIG_THREAD_NAME=y
CONFIG_SEGGER_SYSTEMVIEW=n
CONFIG_TRACING=n
# enable for post-mortem tracing
CONFIG_SEGGER_SYSVIEW_POST_MORTEM_MODE=n

CONFIG_RESET_ON_FATAL_ERROR=y

CONFIG_PRINTK=y
CONFIG_ASSERT=y

CONFIG_LOG=y
CONFIG_LOG_MODE_MINIMAL=n
CONFIG_LOG_BACKEND_UART=n

CONFIG_LOG_DEFAULT_LEVEL=4
CONFIG_LOG_BACKEND_SHOW_COLOR=y
CONFIG_LOG_BACKEND_RTT=y
CONFIG_LOG_PROCESS_THREAD=y

CONFIG_LOG_MODE_DEFERRED=y

CONFIG_CBPRINTF_FP_SUPPORT=y

CONFIG_SPEED_OPTIMIZATIONS=n
CONFIG_SIZE_OPTIMIZATIONS=y

CONFIG_NEWLIB_LIBC=y
CONFIG_NEWLIB_LIBC_FLOAT_PRINTF=y
CONFIG_CPLUSPLUS=y
CONFIG_LIB_CPLUSPLUS=y

CONFIG_SPI=y
CONFIG_NRFX_PPI=y 
CONFIG_NRFX_SPIM2=y
CONFIG_SOC_NRF52832_ALLOW_SPIM_DESPITE_PAN_58=y

CONFIG_HEAP_MEM_POOL_SIZE=32768
```

## decawave_dwm1001_dev.overlay
```dts
// To get started, press Ctrl+Space (or Option+Esc) to bring up the completion menu and view the available nodes.

// You can also use the buttons in the sidebar to perform actions on nodes.
// Actions currently available include:

// * Enabling / disabling the node
// * Adding the bus to a bus
// * Removing the node
// * Connecting ADC channels

// For more help, browse the DeviceTree documentation at https://docs.zephyrproject.org/latest/guides/dts/index.html
// You can also visit the nRF DeviceTree extension documentation at https://nrfconnect.github.io/vscode-nrf-connect/devicetree/nrfdevicetree.html

&spi2 {
	compatible = "nordic,nrf-spim";
    status = "disabled";
    // anomaly-58-workaround;
};


&ieee802154 {
	status = "disabled";
};

&uart0 {
	compatible = "nordic,nrf-uarte";
	status = "disabled";
};
```

## src/main.c
```c
/**
 * @file main.c
 * @author Vit Petrik (petrivi2@fel.cvut.cz)
 * @brief Main entry point to UWB positioning sytem
 * @version 0.1
 * @date 2022-11-15
 *
 * @copyright Copyright (c) 2022
 *
 */

#include <zephyr/kernel.h>
#include <zephyr/sys/__assert.h>
#include <zephyr/timing/timing.h>

#include <zephyr/sys/reboot.h>
#include <zephyr/logging/log.h>
#include <zephyr/logging/log_ctrl.h>
LOG_MODULE_REGISTER(main, 2);

#include <zephyr/device.h>
#include <zephyr/devicetree.h>
#include <zephyr/drivers/sensor.h>
#include <zephyr/drivers/uart.h>
#include <zephyr/drivers/gpio.h>
#include <zephyr/drivers/spi.h>
#include <string.h>
#include <stdbool.h>

#include <stdio.h>

#include "deca_regs.h"
#include "platform.h"

#include "common_types.h"
#include "common_macro.h"
#include "common_variables.h"
#include "uwb_threads.h"
#include "uwb_transport.h"
#include "ranging.h"

#include "mac.h"
#include "uart.h"
#include "ros.h"

/* Example application name and version to display on LCD screen. */
#define APP_NAME "MRS UWB v0.1"
const char *buildString = "Build was compiled at " __DATE__ ", " __TIME__ ".";

uint16_t DEVICE_ID;
uint16_t PAN_ID;
uint8_t SEQ_NUM;

struct mrs_ranging_t mrs_ranging;

// UART

#define UART_DEVICE_NODE DT_NODELABEL(uart0)
struct device *uart_dev = DEVICE_DT_GET(UART_DEVICE_NODE);

// LEDS

static const struct gpio_dt_spec led0red = GPIO_DT_SPEC_GET(DT_NODELABEL(led0_red), gpios);
static const struct gpio_dt_spec led1green = GPIO_DT_SPEC_GET(DT_NODELABEL(led1_green), gpios);
static const struct gpio_dt_spec led2red = GPIO_DT_SPEC_GET(DT_NODELABEL(led2_red), gpios);
static const struct gpio_dt_spec led3blue = GPIO_DT_SPEC_GET(DT_NODELABEL(led3_blue), gpios);

// BUTTONS

#define SW0_NODE	DT_ALIAS(sw0)
#if !DT_NODE_HAS_STATUS(SW0_NODE, okay)
#error "Unsupported board: sw0 devicetree alias is not defined"
#endif
static const struct gpio_dt_spec button = GPIO_DT_SPEC_GET_OR(SW0_NODE, gpios,
							      {0});
static struct gpio_callback button_cb_data;

/* Default communication configuration. We use here EVK1000's mode 4. See NOTE 1 below. */
static dwt_config_t config = {
    5,               /* Channel number. */
    DWT_PRF_64M,     /* Pulse repetition frequency. */
    DWT_PLEN_128,    /* Preamble length. Used in TX only. */
    DWT_PAC8,        /* Preamble acquisition chunk size. Used in RX only. */
    9,               /* TX preamble code. Used in TX only. */
    9,               /* RX preamble code. Used in RX only. */
    0,               /* 0 to use standard SFD, 1 to use non-standard SFD. */
    DWT_BR_6M8,      /* Data rate. */
    DWT_PHRMODE_STD, /* PHY header mode. */
    (128 + 8 + 1)    /* SFD timeout (preamble length + 1 + SFD length - PAC size). Used in RX only. */
};


K_MSGQ_DEFINE(uwb_msgq, sizeof(struct uwb_msg_t), 10, 4);

// Threads declarations

/**
 * @brief Receive and process data from ROS (or PC)
 *
 */
void ros_rx_thread(void);
void ros_tx_thread(void);

void uwb_multiplex_rx();

// Threads definitions

K_THREAD_DEFINE(ros_rx_thr, 1024, ros_rx_thread, NULL, NULL, NULL, 6, 0, 0);
K_THREAD_DEFINE(ros_tx_thr, 1024, ros_tx_thread, NULL, NULL, NULL, 6, 0, 0);

K_THREAD_DEFINE(uwb_ranging_thr, 1024, uwb_ranging_thread, NULL, NULL, NULL, 5, 0, 0);

// K_THREAD_DEFINE(ranging_thr, 1024, ranging_thread, NULL, NULL, NULL, -3, 0, 0);
K_THREAD_DEFINE(uwb_multiplex_thr, 1024, uwb_multiplex_rx, NULL, NULL, NULL, -3, 0, 0);
K_THREAD_DEFINE(uwb_tx_thr, 1024, uwb_tx_thread, NULL, NULL, NULL, -2, 0, 0);

// CALLBACKS

void send_anchor_beacon_cb(struct k_timer *timer);
K_TIMER_DEFINE(send_anchor_beacon_timer, send_anchor_beacon_cb, NULL);

void alive_msg_cb(struct k_timer *timer);
K_TIMER_DEFINE(alive_msg_timer, alive_msg_cb, NULL);

void button_pressed(const struct device *dev, struct gpio_callback *cb, uint32_t pins);

/**
 * @brief Set up the DW1000 tranciever
 * 
 */
void setup_dwt()
{
    // Get DWT Mutex
    k_mutex_init(&dwt_mutex);
    k_mutex_lock(&dwt_mutex, K_FOREVER);

    // Reset DWT to delete previous config
    dwt_hardreset();
    dwt_hardinterrupt(dwm_int_callback);

    // The SPI need to be set to lower speed setting
    dwt_spi_set_rate_slow();

    __ASSERT_NO_MSG(dwt_initialise(DWT_LOADUCODE) == DWT_SUCCESS);

    // Now, we can enable full speed on SPI bus
    dwt_spi_set_rate_fast();

    // Set our configuration
    dwt_configure(&config);

    // Set transimtting power
    //! Need later revision
    dwt_txconfig_t txconfig = {.PGdly = 0xC0, .power = 0x25466788};
    dwt_configuretxrf(&txconfig);
    dwt_setsmarttxpower(true);

    dwt_setleds(DWT_LEDS_ENABLE);

    //? Might need to be changed from ROS
    dwt_setaddress16(DEVICE_ID);
    dwt_setpanid(PAN_ID);

    // Enable frame filtering and rejection
    dwt_enableframefilter(DWT_FF_DATA_EN | DWT_FF_MAC_EN, true);
    dwt_setdblrxbuffmode(1);

    //? Experimentaly set antenna delays
    //? Not that much accurate
    dwt_settxantennadelay(21875);
    dwt_setrxantennadelay(21875);

    dwt_setcallbacks(uwb_txdone, uwb_rxok, uwb_rxto, uwb_rxerr, uwb_rxfrej);

    dwt_setinterrupt(DWT_INT_TFRS | DWT_INT_RFCG | DWT_INT_RXOVRR | DWT_INT_RFSL | DWT_INT_RFCE | DWT_INT_RPHE, 1);
    dwt_enable_interrupt();

    dwt_rxenable(DWT_START_RX_IMMEDIATE);

    k_mutex_unlock(&dwt_mutex);

    LOG_INF("Settings done!");
}

void main(void)
{
    // INITIALIZE
    LOG_INF("%s", APP_NAME);
    LOG_INF("%s", buildString);

    timing_init();
    timing_start();

    // Initiliaze LEDs GPIO
    gpio_pin_configure_dt(&led0red, GPIO_OUTPUT_INACTIVE);
    gpio_pin_configure_dt(&led1green, GPIO_OUTPUT_INACTIVE);
    gpio_pin_configure_dt(&led2red, GPIO_OUTPUT_INACTIVE);
    gpio_pin_configure_dt(&led3blue, GPIO_OUTPUT_INACTIVE);

    // Set button interrupt
    gpio_pin_configure_dt(&button, GPIO_INPUT);
    gpio_pin_interrupt_configure_dt(&button, GPIO_INT_EDGE_TO_ACTIVE);
	gpio_init_callback(&button_cb_data, button_pressed, BIT(button.pin));
	gpio_add_callback(button.port, &button_cb_data);

    // Set UART communications for ROS 
    uart_setup();

    // Set global state data
    mrs_ranging.control == UNDETERMINED;
    mrs_ranging.dwt_config = config;

    // Wait loop to determine whether to use Standalone or ROS mode
    // It's dead simple but works as intended
    for (int i = 0; i < 14; i++)
    {
        if (mrs_ranging.control != UNDETERMINED)
            break;

        gpio_pin_toggle_dt(&led3blue);
        sleep_ms(400);
    }

    // make sure the blue LED is switched OFF
    gpio_pin_set_dt(&led3blue, 0);

    // If the user did not pressed the button
    // then set ROS mode
    if (mrs_ranging.control == UNDETERMINED)
        mrs_ranging.control = ROS;

    LOG_INF("Selected mode: %s", mrs_ranging.control == ROS ? "ROS" : "STANDALONE");

    mrs_ranging.L2_address = NRF_FICR->DEVICEID[0] >> 16;
    mrs_ranging.PAN_ID = 0xabcd;

    DEVICE_ID = NRF_FICR->DEVICEID[0] >> 16;
    PAN_ID = 0xabcd;
    SEQ_NUM = 0;

    setup_dwt();

    // Start threads based on control mode
    if (mrs_ranging.control == STANDALONE)
    {
        k_thread_abort(uwb_ranging_thr);
        k_thread_abort(ros_tx_thr);

        k_timer_start(&send_anchor_beacon_timer, K_SECONDS(0), K_SECONDS(1));
    }
    else
    {
        k_thread_resume(uwb_ranging_thr);
        k_thread_resume(ros_tx_thr);
        k_timer_stop(&send_anchor_beacon_timer);

        k_timer_stop(&alive_msg_timer);
    }

    k_thread_resume(ros_rx_thr);
    k_thread_resume(uwb_multiplex_thr);
    k_thread_resume(uwb_tx_thr);

    LOG_INF("Device ID: 0x%X", DEVICE_ID);

    //? Heart beat LED
    //? Good to recognize bad things happening.. SEG FAULT etc.

    while (1)
    {
        gpio_pin_set_dt(&led1green, 1);
        sleep_ms(200);
        gpio_pin_set_dt(&led1green, 0);
        sleep_ms(200);
        gpio_pin_set_dt(&led1green, 1);
        sleep_ms(200);
        gpio_pin_set_dt(&led1green, 0);
        sleep_ms(600);
    }

    return;
}

void button_pressed(const struct device *dev, struct gpio_callback *cb, uint32_t pins)
{
    if (mrs_ranging.control == UNDETERMINED)
        mrs_ranging.control = STANDALONE;

    return;
}

void uwb_multiplex_rx()
{
    k_tid_t thread = k_current_get();
    k_thread_suspend(thread);

    int status;

    LOG_INF("UWB multiplex thread started");
    struct rx_queue_t data;

    struct uwb_msg_t msg;

    while (1)
    {
        // wait for data
        read_uwb(&data);

        int source_id = data.mac_data.source_id;
        struct rx_details_t *rx_details = &data.rx_details;

        void *offseted_buf = &data.buffer_rx[data.buf_offset];

        LOG_HEXDUMP_DBG(offseted_buf, data.frame_length, "Received data from UWB");

        switch (data.mac_data.msg_type)
        {
        case RANGING_TYPE:
            // Handle only ranging data
            rx_ranging_ds(source_id, offseted_buf, rx_details);
            break;
        default:
            if(mrs_ranging.control == STANDALONE)
                break;
            // If generic data is received than send it over UART to ROS
            msg.msg_type = UWB_DATA;
            msg.data.uwb_data_msg.source_mac = source_id;
            msg.data.uwb_data_msg.destination_mac = data.mac_data.destination_id;
            msg.data.uwb_data_msg.msg_type = data.mac_data.msg_type;
            msg.data.uwb_data_msg.payload_size = data.frame_length;

            msg.data.uwb_data_msg.payload = k_malloc(msg.data.uwb_data_msg.payload_size);
            __ASSERT(msg.data.uwb_data_msg.payload != NULL, "Failed to allocate buffer");

            memcpy(msg.data.uwb_data_msg.payload, offseted_buf, msg.data.uwb_data_msg.payload_size);

            status = k_msgq_put(&uwb_msgq, &msg, K_FOREVER);
            __ASSERT(status == 0, "Putting message to queue Failed!");

            break;
        }

        k_free(data.buffer_rx);
    }
}

void send_anchor_beacon(struct k_work *work)
{
    // if in standalone mode send Anchor data
    struct tx_details_t tx_details = {
        .ranging = 0,
        .tx_mode = DWT_START_TX_IMMEDIATE | DWT_RESPONSE_EXPECTED,
        .tx_timestamp = NULL};

    struct anchor_msg_t anchor_msg;

    anchor_msg.address = ANCHOR_BEACON;
    anchor_msg.mode = 'w';
    anchor_msg.data.anchor_beacon.capabilities = RDEV;

    uint8_t buffer[sizeof(struct anchor_msg_t)];

    int msg_length = serialize_anchor_msg(&anchor_msg, buffer);

    LOG_HEXDUMP_DBG(buffer, msg_length, "Sending anchor packet");

    write_uwb(0xffff, DATA, ANCHOR_TYPE, buffer, msg_length, &tx_details);

    return;
}

K_WORK_DEFINE(send_anchor_work, send_anchor_beacon);

void send_anchor_beacon_cb(struct k_timer *timer)
{
    k_work_submit(&send_anchor_work);
    return;
}

void alive_msg_cb(struct k_timer *timer)
{
    struct baca_protocol msg_tx;
    struct ros_msg_t ros;
    msg_tx.payload = k_malloc(256);

    ros.address = WHO_I_AM;
    ros.mode = 'w';
    memcpy(ros.data.id_msg.id, APP_NAME, sizeof(APP_NAME));
    
    msg_tx.payload_size = serialize_ros(&ros, msg_tx.payload);
    write_baca(&msg_tx);
    k_free(msg_tx.payload);
    return;
}

void ros_tx_thread(void)
{
    struct baca_protocol msg_tx;
    struct ros_msg_t ros;

    struct uwb_msg_t uwb_msg;

    msg_tx.payload = k_malloc(256);
    __ASSERT(msg_tx.payload != NULL, "Failed to allocate buffer!");

    while (1)
    {
        // Get data from UWB
        int status = k_msgq_get(&uwb_msgq, (void *)&uwb_msg, K_FOREVER);
        gpio_pin_set_dt(&led2red, 1);

        if (status != 0)
            continue;

        // Setup message
        switch (uwb_msg.msg_type)
        {
        case RANGING_DATA:
            ros.address = RANGING_RESULT;
            ros.mode = 'w';

            ros.data.ranging_msg = uwb_msg.data.ranging_msg;
            break;
        case UWB_DATA:
            ros.address = TRX_DATA;
            ros.mode = 'w';

            ros.data.uwb_data_msg = uwb_msg.data.uwb_data_msg;
            break;
        default:
            break;
        }

        // Serialize and send the data
        msg_tx.payload_size = serialize_ros(&ros, msg_tx.payload);
        write_baca(&msg_tx);

        gpio_pin_set_dt(&led2red, 0);
    }

    k_free(msg_tx.payload);
}

/**
 * @brief Receive and process data from ROS
 *
 */
void ros_rx_thread(void)
{
    struct baca_protocol msg_rx;
    struct baca_protocol msg_tx;
    struct ros_msg_t ros;

    msg_tx.payload = k_malloc(256);
    bool request_send;

    struct tx_details_t tx_details = {
        .ranging = 0,
        .tx_mode = DWT_START_TX_IMMEDIATE | DWT_RESPONSE_EXPECTED,
        .tx_timestamp = NULL};

    while (1)
    {
        // Read data from UART send over BACA
        int payload_length = read_baca(&msg_rx);

        if (payload_length < 0)
        {
            LOG_INF("Received wrong checksum! Discarding the data");
            continue;
        }

        LOG_HEXDUMP_DBG(msg_rx.payload, payload_length, "Received buffer from ROS");

        gpio_pin_set_dt(&led3blue, 1);
        deserialize_ros(&ros, msg_rx.payload);

        k_free(msg_rx.payload);

        LOG_DBG("Ros command at address: 0x%X", ros.address);
        request_send = false;

        // handle the data based on address
        switch (ros.address)
        {
        case WHO_I_AM:
            if (ros.mode != 'r')
                break;
            LOG_DBG("Received WHO_I_AM request");
            ros.mode = 'w';
            memcpy(ros.data.id_msg.id, APP_NAME, sizeof(APP_NAME));
            request_send = true;
            break;
        case TRX_DATA:
            LOG_HEXDUMP_DBG(ros.data.uwb_data_msg.payload, ros.data.uwb_data_msg.payload_size, "Sending TRX data");
            write_uwb(ros.data.uwb_data_msg.destination_mac,
                      DATA,
                      ros.data.uwb_data_msg.msg_type,
                      ros.data.uwb_data_msg.payload,
                      ros.data.uwb_data_msg.payload_size,
                      &tx_details);

            k_free(ros.data.uwb_data_msg.payload);
            break;
        case RESET:
            log_panic();
            LOG_INF("Rebooting system on request from ROS");
            sys_reboot(0);
            break;
        case ROS_CONTROL:
            if (mrs_ranging.control == UNDETERMINED)
                mrs_ranging.control = ros.data.control;
            break;
        case REQUEST_RANGING:
            request_ranging(ros.data.request_ranging.target_id, ros.data.request_ranging.preprocessing);
            break;
        default:
            break;
        }

        gpio_pin_set_dt(&led3blue, 0);

        if (!request_send)
            continue;

        msg_tx.payload_size = serialize_ros(&ros, msg_tx.payload);
        write_baca(&msg_tx);

        LOG_HEXDUMP_DBG(msg_tx.payload, msg_tx.payload_size, "Tx to ROS");
    }
}
```

## inc/common_macro.h
```c
#ifndef __COMMON_MACRO_H__
#define __COMMON_MACRO_H__

#include <zephyr/zephyr.h>

#define sleep_ms(ms) k_sleep(K_MSEC(ms))

#endif
```

## inc/common_types.h
```c
#ifndef __COMMON_TYPES_H__
#define __COMMON_TYPES_H__

#include <zephyr/zephyr.h>
#include "deca_device_api.h"

#include "mac.h"
#include "statistics.h"

#define PACKED __attribute__((__packed__))

typedef enum {
    UNDETERMINED,
    STANDALONE,
    ROS
} control_t;

struct mrs_ranging_t {
    control_t control;
    dwt_config_t dwt_config;

    uint16_t L2_address;
    uint16_t PAN_ID;
};

typedef enum
{
    BEACON = 0,
    DATA,
    ACK,
    MAC_COMMAND,
    MRS_BEACON,
    RESERVED_2,
    RESERVED_3,
    RESERVED_4,
} frame_type_t;

struct rx_details_t
{
    uint64_t rx_timestamp;
    int32_t carrier_integrator;
    uint32_t tx_delay;
    float rx_power;
};

struct rx_queue_t
{
    uint8_t buf_offset;
    struct rx_details_t rx_details;
    struct mac_data_t mac_data;
    uint16_t frame_length;
    uint8_t *buffer_rx;
}__attribute__((aligned(4)));

struct tx_delay_t
{
    uint64_t rx_timestamp;
    uint32_t reserved_time;
    int offset;
};

struct tx_details_t
{
    int ranging;
    uint8_t tx_mode;
    uint64_t *tx_timestamp;
    struct tx_delay_t tx_delay;
};

struct tx_queue_t
{
    struct tx_details_t tx_details;
    struct mac_data_t mac_data;
    uint16_t frame_length;
    uint8_t *frame_buffer;
}__attribute__((aligned(4)));

// DATA STRUCTURE DEFINITIONS

struct ranging_msg_t {
    uint16_t source_mac;

    float range;
    float variance;

    float raw;

    float power_a;
    float power_b;
};

struct uwb_data_msg_t {
    uint16_t source_mac;
    uint16_t destination_mac;

    uint8_t msg_type;
    uint8_t payload_size;
    uint8_t *payload;
};

enum {
    RANGING_DATA,
    UWB_DATA
};

struct uwb_msg_t {
    uint8_t msg_type;

    union {
        struct ranging_msg_t ranging_msg;
        struct uwb_data_msg_t uwb_data_msg;
    } data;
}__attribute__((aligned(4)));

#endif
```

## inc/common_variables.h
```c
/**
 * @file common_variables.h
 * @author Vit Petrik (petrivi2@fel.cvut.cz)
 * @brief Declarations of global variables
 * @version 0.1
 * @date 2022-11-16
 * 
 * @copyright Copyright (c) 2022
 * 
 */

#ifndef __GLOBAL_VARIABLES_H__
#define __GLOBAL_VARIABLES_H__

#include <zephyr/zephyr.h>
#include <zephyr/device.h>
#include "common_types.h"

extern struct mrs_ranging_t mrs_ranging;

extern uint16_t DEVICE_ID;
extern uint16_t PAN_ID;
extern uint8_t SEQ_NUM;

extern struct k_msgq uwb_tx_msgq;
extern struct k_msgq uwb_rx_msgq;

extern struct k_msgq uwb_msgq;

extern struct k_mutex dwt_mutex;

extern struct device *uart_dev;

#endif
```

## inc/ros.h
```c
/**
 * @file ros.h
 * @author Vit Petrik (petrivi2@fel.cvut.cz)
 * @brief Definitions of structures and functions for ROS communication
 * @version 0.1
 * @date 2022-11-30
 *
 * @copyright Copyright (c) 2022
 *
 */

#ifndef __ROS_H__
#define __ROS_H__

#include "stdio.h"

#include "common_types.h"
#include "ranging.h"

enum PACKET_MSG_TYPES
{
    ROS_TYPE,
    ANCHOR_TYPE,
    RANGING_TYPE = RANGING_MSG_TYPE
};

enum address_t
{
    WHO_I_AM,
    RADIO_CONFIG,
    RANGING_MODE,
    RANGING_RESULT,
    TRX_DATA,
    RESET,
    ROS_CONTROL,
    REQUEST_RANGING,
};

struct ros_id_msg_t
{
    char id[16];
};

struct ros_radio_config_msg_t
{
};

struct ros_ranging_mode_msg_t
{
};

struct request_ranging_t
{
    uint16_t target_id;
    uint8_t preprocessing;
};

struct ros_msg_t
{
    uint8_t address;
    char mode;
    union
    {
        struct ros_id_msg_t id_msg;
        struct ros_radio_config_msg_t radio_config_msg;
        struct ros_ranging_mode_msg_t ranging_mode_msg;
        struct ranging_msg_t ranging_msg;
        struct uwb_data_msg_t uwb_data_msg;
        uint8_t reset;
        uint8_t control;
        struct request_ranging_t request_ranging;
    } data;
};

enum address_anchor_t
{
    ANCHOR_BEACON,
};

enum capabilities_t
{
    NONE,
    RDEV
};

struct anchor_beacon_t
{
    uint8_t capabilities;
};

struct anchor_msg_t
{
    uint8_t address;
    char mode;

    union
    {
        struct anchor_beacon_t anchor_beacon;
    } data;
};

#ifdef __cplusplus
extern "C"
{
#endif

    /**
     * @brief Serialize ros_msg_t to buffer
     *
     * @param msg pointer to ros_msg_t structure
     * @param buf pointer to buffer
     * @return int returns the overall size of serialized data
     */
    int serialize_ros(const struct ros_msg_t *msg, uint8_t *buf);

    /**
     * @brief Deserialize buffer data to ros_msg_t
     *
     * @param msg pointer to ros_msg_t structure
     * @param buf pointer to buffer in which the data lies
     */
    void deserialize_ros(struct ros_msg_t *msg, const uint8_t *buf);

    /**
     * @brief Serialize anchor_msg_t to buffer
     * 
     * @param msg pointer to anchor_msg_t structure
     * @param buf pointer to buffer
     * @return int returns the overall size of serialized data
     */
    int serialize_anchor_msg(const struct anchor_msg_t *msg, uint8_t *buf);

#ifdef __cplusplus
}
#endif

#endif
```

## inc/statistics.h
```c
/**
 * @file statistics.h
 * @author Vit Petrik (petrivi2@fel.cvut.cz)
 * @brief Little library to do some statistics
 * @version 0.1
 * @date 2022-12-03
 * 
 * @copyright Copyright (c) 2022
 * 
 */

#ifndef __STATISTICS_H__
#define __STATISTICS_H__

#include <zephyr/sys/ring_buffer.h>

struct statistics_t {
    int init;
    float mean;
    float sum2;
    float raw;
    int step;
    int window_size;
    struct ring_buf ring_val;
    struct ring_buf ring_sum;
};

#ifdef __cplusplus
 extern "C" {
#endif

/**
 * @brief Initialize struct for handling statistics data
 * 
 * @param stats pointer to statistics_t
 * @param size size of ring buffer (aka sliding window size)
 */
void stats_init(struct statistics_t *stats, int size);

/**
 * @brief Checks whether the stats is initialized
 * 
 * @param stats pointer to statistics_t
 * @return int status of the instance
 */
int stats_is_initialized(struct statistics_t *stats);

/**
 * @brief Update statistics with new value
 * 
 * @param stats pointer to statistics_t 
 * @param val new value
 */
void stats_update(struct statistics_t *stats, const float val);

/**
 * @brief Reset struct to default statw
 * 
 * @param stats pointer to statistics_t
 */
void stats_reset(struct statistics_t *stats);

/**
 * @brief Destroy dynamic arrays
 * 
 * @param stats pointer to statistics_t
 */
void stats_destroy(struct statistics_t *stats);

/**
 * @brief Gets value of mean
 * 
 * @param stats pointer to structure_t
 * @return float mean
 */
float stats_get_mean(const struct statistics_t *stats);

/**
 * @brief Gets value of mean
 * 
 * @param stats pointer to structure_t
 * @return float raw value
 */
float stats_get_raw(const struct statistics_t *stats);

/**
 * @brief Gets value of variance
 * 
 * @param stats pointer to structure_t
 * @return float variance
 */
float stats_get_variance(const struct statistics_t *stats);

/**
 * @brief Gets step of calculation
 * 
 * @param stats pointer to structure_t
 * @return int step
 */
int stats_get_step(const struct statistics_t *stats);

/**
 * @brief Gets size of averaging windows
 *
 * @param stats pointer to strcutre_t
 * @return int windows size
 */
int stats_get_window_size(const struct statistics_t *stats);

#ifdef __cplusplus
}
#endif

#endif
```

## inc/uart.h
```c
/**
 * @file uart.h
 * @author Vit Petrik (petrivi2@fel.cvut.cz)
 * @brief Threads to handle ROS communication at the lowest level
 * @version 0.1
 * @date 2022-11-16
 *
 * @copyright Copyright (c) 2022
 *
 */

#ifndef __UART_H__
#define __UART_H__


#include <zephyr/zephyr.h>
#include <zephyr/drivers/uart.h>

struct baca_protocol {
    uint8_t cksum;

    uint8_t payload_size;
    uint8_t *payload;
};

#pragma once
#ifdef __cplusplus
extern "C"
{
#endif

/**
 * @brief Setup UART peripherial
 * 
 */
void uart_setup();

/**
 * @brief Write buffer to COM port
 * 
 * @param data pointer to data
 * @param data_length length of the data in uint8_t size
 * @return uint8_t returns checksum of sent data
 */
uint8_t calc_cksum(uint8_t *data, int data_length);

/**
 * @brief Write buffer accoring to BACA protocol
 * 
 * @param data pointer to data
 * @param data_length length of the data in uint8_t size
 */
void write_baca(struct baca_protocol *msg);

/**
 * @brief Read data into buffer
 * 
 * @param buffer pointer to received payload
 * @param buflen length of the buffer
 * @return int length of received data
 */
int read_baca(struct baca_protocol *msg);

/**
 * @brief Write single character
 * 
 * @param c
 */
void write_char(uint8_t c);

/**
 * @brief Write buffer to UART
 * 
 * @param buffer pointer to buffer that needs to be written out
 * @param len length of the data
 */
void write_buffer(uint8_t *buffer, int len);

/**
 * @brief Read single character
 * 
 * @return uint8_t character from UART
 */
uint8_t read_char();

/**
 * @brief Read bigger chunk of data to buffer
 * 
 * @param buf pointer to buffer
 * @param len length of the data to be received
 */
int read_buffer(uint8_t *buf, int len, k_timeout_t timeout);

#ifdef __cplusplus
}
#endif

#endif
```

## inc/uwb_threads.h
```c
/**
 * @file uwb_threads.h
 * @author Vit Petrik (petrivi2@fel.cvut.cz)
 * @brief 
 * @version 0.1
 * @date 2022-11-15
 * 
 * @copyright Copyright (c) 2022
 * 
 */

#ifndef __UWB_THREADS_H__
#define __UWB_THREADS_H__

#include "deca_device_api.h"

/**
 * @brief Transmitting thread, waits for queue
 *
 */
void uwb_tx_thread(void);

/**
 * @brief Thread that handles dwt interrupts, gets woken up by interrupt
 * 
 */
void dwt_isr_handler(struct k_work *item);

/**
 * @brief Interrupt Transission is dones
 * 
 * @param data Pointer to callback data
 */
void uwb_txdone(const dwt_cb_data_t *data);

/**
 * @brief Receiver timeout interrupt
 * 
 * @param data Pointer to callback data
 */
void uwb_rxto(const dwt_cb_data_t *data);

/**
 * @brief Receiver error interrupt
 * 
 * @param data Pointer to callback data
 */
void uwb_rxerr(const dwt_cb_data_t *data);

/**
 * @brief Receiver frame rejection interrupt
 * 
 * @param data Pointer to callback data
 */
void uwb_rxfrej(const dwt_cb_data_t *data);

/**
 * @brief Receiver successful
 * 
 * @param data Pointer to callback data
 */
void uwb_rxok(const dwt_cb_data_t *data);

/**
 * @brief Gets called when UWB trigger hardware reciver
 * 
 * @param dev Pointer to GPIO Bank
 * @param cb Callback data
 * @param pins Pin that got interrupted
 */
void dwm_int_callback(const struct device *dev, struct gpio_callback *cb, uint32_t pins);

#endif
```

## inc/uwb_transport.h
```c
/**
 * @file uwb_transport.h
 * @author Vit Petrik (petrivi2@fel.cvut.cz)
 * @brief Transport layer for UWB
 * @version 0.1
 * @date 2022-11-15
 *
 * @copyright Copyright (c) 2022
 *
 */

#ifndef __UWB_TRANSPORT_H__
#define __UWB_TRANSPORT_H__

#include <zephyr/zephyr.h>
#include "common_types.h"
#include "ranging.h"
#include "mac.h"

#pragma once
#ifdef __cplusplus
extern "C"
{
#endif

/**
 * @brief Transport data to tx queue
 *
 * @param destination_id id of destinatio uwb
 * @param frame_type Type of frame DATA/BEACON...
 * @param msg_type Type of message
 * @param msg pointer to message data
 * @param len length of the message data
 * @param tx_details details of the transission e.g timestamp...
 */
void write_uwb(const uint16_t destination_id, const frame_type_t frame_type, const int msg_type, const uint8_t *msg, int len, struct tx_details_t *tx_details);

/**
 * @brief Wait for input from message queue
 * 
 * @param data pointer to data strucutre where the data will be stored
 * @return int returns status of k_msgq_get
 */
int read_uwb(struct rx_queue_t *data);

#ifdef __cplusplus
}
#endif

#endif
```

## src/ros.c
```c
/**
 * @file ros.c
 * @author Vit Petrik (petrivi2@fel.cvut.cz)
 * @brief Definitions of structures and functions for ROS communication
 * @version 0.1
 * @date 2022-11-30
 *
 * @copyright Copyright (c) 2022
 *
 */

#include "ros.h"
#include <zephyr/sys/__assert.h>

/**
 * ! All of this is using extreamly dumb and repetitive way
 * ! of doing things... more elegant solution might be possible
 * ! but dont change what ain't broken! :-)
 */

/**
 * @brief Serialize ros_msg_t to buffer
 *
 * @param msg pointer to ros_msg_t structure
 * @param buf pointer to buffer
 * @return int returns the overall size of serialized data
 */
int serialize_ros(const struct ros_msg_t *msg, uint8_t *buf)
{
    int index = 0;

    buf[index++] = msg->address;
    buf[index++] = msg->mode;

    if (msg->mode == 'r')
        return index;

    switch (msg->address)
    {
    case WHO_I_AM:
        memcpy(&buf[index], msg->data.id_msg.id, sizeof(msg->data.id_msg.id));
        index += sizeof(msg->data.id_msg.id);
        break;
    case RADIO_CONFIG:
        break;
    case RANGING_MODE:
        break;
    case RANGING_RESULT:
        memcpy(&buf[index], &msg->data.ranging_msg.source_mac, sizeof(msg->data.ranging_msg.source_mac));
        index += sizeof(msg->data.ranging_msg.source_mac);
        memcpy(&buf[index], &msg->data.ranging_msg.range, sizeof(msg->data.ranging_msg.range));
        index += sizeof(msg->data.ranging_msg.range);
        memcpy(&buf[index], &msg->data.ranging_msg.variance, sizeof(msg->data.ranging_msg.variance));
        index += sizeof(msg->data.ranging_msg.variance);
        memcpy(&buf[index], &msg->data.ranging_msg.raw, sizeof(msg->data.ranging_msg.raw));
        index += sizeof(msg->data.ranging_msg.raw);
        memcpy(&buf[index], &msg->data.ranging_msg.power_a, sizeof(msg->data.ranging_msg.power_a));
        index += sizeof(msg->data.ranging_msg.power_a);
        memcpy(&buf[index], &msg->data.ranging_msg.power_b, sizeof(msg->data.ranging_msg.power_b));
        index += sizeof(msg->data.ranging_msg.power_b);
        break;
    case TRX_DATA:
        memcpy(&buf[index], &msg->data.uwb_data_msg.source_mac, sizeof(msg->data.uwb_data_msg.source_mac));
        index += sizeof(msg->data.uwb_data_msg.source_mac);
        memcpy(&buf[index], &msg->data.uwb_data_msg.destination_mac, sizeof(msg->data.uwb_data_msg.destination_mac));
        index += sizeof(msg->data.uwb_data_msg.destination_mac);
        memcpy(&buf[index], &msg->data.uwb_data_msg.msg_type, sizeof(msg->data.uwb_data_msg.msg_type));
        index += sizeof(msg->data.uwb_data_msg.msg_type);
        memcpy(&buf[index], &msg->data.uwb_data_msg.payload_size, sizeof(msg->data.uwb_data_msg.payload_size));
        index += sizeof(msg->data.uwb_data_msg.payload_size);
        memcpy(&buf[index], msg->data.uwb_data_msg.payload, msg->data.uwb_data_msg.payload_size);
        index += msg->data.uwb_data_msg.payload_size;
        k_free(msg->data.uwb_data_msg.payload);
        break;
    case RESET:
        memcpy(&buf[index], &msg->data.reset, sizeof(msg->data.reset));
        index += sizeof(msg->data.reset);
        break;
    case ROS_CONTROL:
        memcpy(&buf[index], &msg->data.control, sizeof(msg->data.control));
        index += sizeof(msg->data.control);
        break;
    default:
        break;
    }

    // index == len at end of the transmission
    return index;
}

/**
 * @brief Desiralize buffer data to ros_msg_t
 *
 * @param msg pointer to ros_msg_t structure
 * @param buf pointer to buffer in which the data lies
 */
void deserialize_ros(struct ros_msg_t *msg, const uint8_t *buf)
{
    int index = 0;

    msg->address = buf[index++];
    msg->mode = buf[index++];

    if (msg->mode == 'r')
        return;

    switch (msg->address)
    {
    case WHO_I_AM:
        memcpy(msg->data.id_msg.id, &buf[index], sizeof(msg->data.id_msg.id));
        index += sizeof(msg->data.id_msg.id);
        break;
    case RADIO_CONFIG:
        break;
    case RANGING_MODE:
        break;
    case RANGING_RESULT:
        memcpy(&msg->data.ranging_msg.source_mac, &buf[index], sizeof(msg->data.ranging_msg.source_mac));
        index += sizeof(msg->data.ranging_msg.source_mac);
        memcpy(&msg->data.ranging_msg.range, &buf[index], sizeof(msg->data.ranging_msg.range));
        index += sizeof(msg->data.ranging_msg.range);
        memcpy(&msg->data.ranging_msg.variance, &buf[index], sizeof(msg->data.ranging_msg.variance));
        index += sizeof(msg->data.ranging_msg.variance);
        memcpy(&msg->data.ranging_msg.raw, &buf[index], sizeof(msg->data.ranging_msg.raw));
        index += sizeof(msg->data.ranging_msg.raw);
        break;
    case TRX_DATA:
        memcpy(&msg->data.uwb_data_msg.source_mac, &buf[index], sizeof(msg->data.uwb_data_msg.source_mac));
        index += sizeof(msg->data.uwb_data_msg.source_mac);
        memcpy(&msg->data.uwb_data_msg.destination_mac, &buf[index], sizeof(msg->data.uwb_data_msg.destination_mac));
        index += sizeof(msg->data.uwb_data_msg.destination_mac);
        memcpy(&msg->data.uwb_data_msg.msg_type, &buf[index], sizeof(msg->data.uwb_data_msg.msg_type));
        index += sizeof(msg->data.uwb_data_msg.msg_type);
        memcpy(&msg->data.uwb_data_msg.payload_size, &buf[index], sizeof(msg->data.uwb_data_msg.payload_size));
        index += sizeof(msg->data.uwb_data_msg.payload_size);

        msg->data.uwb_data_msg.payload = k_malloc(msg->data.uwb_data_msg.payload_size);
        __ASSERT(msg->data.uwb_data_msg.payload != NULL, "Failed to allocate buffer!");

        memcpy(msg->data.uwb_data_msg.payload, &buf[index], msg->data.uwb_data_msg.payload_size);
        index += msg->data.uwb_data_msg.payload_size;
        break;
    case RESET:
        memcpy(&msg->data.reset, &buf[index], sizeof(msg->data.reset));
        index += sizeof(msg->data.reset);
        break;
    case ROS_CONTROL:
        memcpy(&msg->data.control, &buf[index], sizeof(msg->data.control));
        index += sizeof(msg->data.control);
        break;
    case REQUEST_RANGING:
        memcpy(&msg->data.request_ranging.target_id, &buf[index], sizeof(msg->data.request_ranging.target_id));
        index += sizeof(msg->data.request_ranging.target_id);
        memcpy(&msg->data.request_ranging.preprocessing, &buf[index], sizeof(msg->data.request_ranging.preprocessing));
        index += sizeof(msg->data.request_ranging.preprocessing);
        break;

    default:
        break;
    }
}

/**
 * @brief Serialize anchor_msg_t to buffer
 * 
 * @param msg pointer to anchor_msg_t structure
 * @param buf pointer to buffer
 * @return int returns the overall size of serialized data
 */
int serialize_anchor_msg(const struct anchor_msg_t *msg, uint8_t *buf)
{
    int index = 0;

    buf[index++] = msg->address;
    buf[index++] = msg->mode;

    switch (msg->address)
    {
    case ANCHOR_BEACON:
        memcpy(&buf[index], &msg->data.anchor_beacon.capabilities, sizeof(msg->data.anchor_beacon.capabilities));
        index += sizeof(msg->data.anchor_beacon.capabilities);
        break;
    default:
        break;
    }

    return index;
}
```

## src/statistics.c
```c
/**
 * @file statistics.c
 * @author Vit Petrik (petrivi2@fel.cvut.cz)
 * @brief Little library to do some statistics
 * @version 0.1
 * @date 2022-12-03
 *
 * @copyright Copyright (c) 2022
 *
 * Calculation of Mean and Variance is based on Welford's algortigm
 * more info at https://nullbuffer.com/articles/welford_algorithm.html
 *
 */

#include <zephyr/sys/__assert.h>
#include "statistics.h"
#include <string.h>

/**
 * @brief Initialize struct for handling statistics data
 *
 * @param stats pointer to statistics_t
 */
void stats_init(struct statistics_t *stats, int size)
{
    if(size < 1)
        size = 1;

    stats->mean = 0;
    stats->raw = 0;
    stats->sum2 = 0;
    stats->step = 0;
    stats->window_size = size;

    stats->init = 1;

    uint32_t *buf_val = k_malloc(2*stats->window_size*sizeof(uint32_t));
    __ASSERT(buf_val != NULL, "Could not allocate buf_val!");

    uint32_t *buf_sum = k_malloc(2*stats->window_size*sizeof(uint32_t));
    __ASSERT(buf_val != NULL, "Could not allocate buf_sum!");

    ring_buf_item_init(&stats->ring_val, stats->window_size, buf_val);
    ring_buf_item_init(&stats->ring_sum, stats->window_size, buf_sum);

    return;
}

/**
 * @brief Checks whether the stats is initialized
 * 
 * @param stats pointer to statistics_t
 * @return int status of the instance
 */
int stats_is_initialized(struct statistics_t *stats)
{
    return stats->init;
}

/**
 * @brief Update statistics with new value
 *
 * @param stats pointer to statistics_t
 * @param val new value
 */
void stats_update(struct statistics_t *stats, const float val)
{
    stats->raw = val;

    if(stats->window_size < 2)
        return;

    if(ring_buf_item_space_get(&stats->ring_val) < 2)
    {
        uint32_t temp;
        float data;

        uint16_t type;
        uint8_t value, size;

        uint32_t buf[2];

        size = 2;

        ring_buf_item_get(&stats->ring_val, &type, &value, buf, &size);
        memcpy(&data, &buf[0], sizeof(float));
        stats->mean = ((stats->mean * stats->step) - data) / (stats->step - 1);

        size = 2;
        ring_buf_item_get(&stats->ring_sum, &type, &value, buf, &size);
        memcpy(&data, &buf[0], sizeof(float));
        stats->sum2 -= data;
        stats->step--;
    }

    float sum = 0;

    if (stats->step == 0)
    {
        stats->mean = stats->raw;
        stats->sum2 = 0;
    }

    else
    {
        float prev = stats->mean;

        stats->mean += (stats->raw - stats->mean) / (stats->step + 1);
        sum = (stats->raw - prev) * (stats->raw - stats->mean);
        stats->sum2 += sum;
    }

    ring_buf_item_put(&stats->ring_val, 0, 0, &stats->raw, 1);
    ring_buf_item_put(&stats->ring_sum, 0, 0, &sum, 1);

    stats->step++;
    return;
}

/**
 * @brief Reset struct to default statw
 *
 * @param stats pointer to statistics_t
 */
void stats_reset(struct statistics_t *stats)
{
    stats->mean = 0;
    stats->raw = 0;
    stats->sum2 = 0;
    stats->step = 0;

    ring_buf_reset(&stats->ring_val);
    ring_buf_reset(&stats->ring_sum);

    return;
}

/**
 * @brief Destroy dynamic arrays
 * 
 * @param stats pointer to statistics_t
 */
void stats_destroy(struct statistics_t *stats)
{
    stats->init = 0;
    k_free(stats->ring_sum.buffer);
    k_free(stats->ring_val.buffer);

    return;
}

/**
 * @brief Gets value of mean
 *
 * @param stats pointer to structure_t
 * @return float mean
 */
float stats_get_mean(const struct statistics_t *stats)
{
    if(stats->window_size < 2)
        return stats_get_raw(stats);

    return stats->mean;
}

/**
 * @brief Gets value of mean
 *
 * @param stats pointer to structure_t
 * @return float raw value
 */
float stats_get_raw(const struct statistics_t *stats)
{
    return stats->raw;
}

/**
 * @brief Gets value of variance
 *
 * @param stats pointer to structure_t
 * @return float variance
 */
float stats_get_variance(const struct statistics_t *stats)
{
    if (stats->step < 2)
        return stats->mean;

    return stats->sum2 / (stats->step - 1);
}

/**
 * @brief Gets step of calculation
 *
 * @param stats pointer to structure_t
 * @return int step
 */
int stats_get_step(const struct statistics_t *stats)
{
    return stats->step;
}

/**
 * @brief Gets size of averaging windows
 *
 * @param stats pointer to strcutre_t
 * @return int windows size
 */
int stats_get_window_size(const struct statistics_t *stats)
{
    return stats->window_size;
}
```

## src/uart.c
```c
/**
 * @file uart.c
 * @author Vit Petrik (petrivi2@fel.cvut.cz)
 * @brief Threads to handle ROS communication at the lowest level
 * @version 0.1
 * @date 2022-11-16
 * 
 * @copyright Copyright (c) 2022
 * 
 */

#include <zephyr/kernel.h>
#include <zephyr/sys/__assert.h>
#include "uart.h"
#include <string.h>

#include <nrfx_uarte.h>
#include <nrfx_gpiote.h>

#include <stdio.h>

#include "common_variables.h"
#include "common_macro.h"

/** Position of the pin field. */
#define NRF_PIN_POS 0U
/** Mask for the pin field. */
#define NRF_PIN_MSK 0x7FU

#define NRF_PINSEL(port, pin)						       \
	(((((port) * 32U) + (pin)) & NRF_PIN_MSK) << NRF_PIN_POS)

K_SEM_DEFINE(rx_sem, 0, 1);
K_SEM_DEFINE(tx_sem, 1, 1);

/** @brief Symbol specifying UARTE instance to be used. */
#define UARTE_INST_IDX 0

/** @brief Symbol specifying TX pin number of UARTE. */
#define UARTE_TX_PIN NRF_PINSEL(0, 5)

/** @brief Symbol specifying RX pin number of UARTE. */
#define UARTE_RX_PIN NRF_PINSEL(0, 11)

#define UARTE_INST         NRFX_CONCAT_2(NRF_UARTE, UARTE_INST_IDX)
#define UARTE_INST_HANDLER NRFX_CONCAT_3(nrfx_uarte_, UARTE_INST_IDX, _irq_handler)

nrfx_uarte_t uarte_inst = NRFX_UARTE_INSTANCE(UARTE_INST_IDX);
nrfx_uarte_config_t uarte_config = NRFX_UARTE_DEFAULT_CONFIG(UARTE_TX_PIN, UARTE_RX_PIN);

/**
 * @brief Function for handling UARTE driver events.
 *
 * @param[in] p_event   Pointer to event structure. Event is allocated on the stack so it is available
 *                      only within the context of the event handler.
 * @param[in] p_context Context passed to the interrupt handler, set on initialization. In this example
 *                      p_context is used to pass the address of the UARTE instance that calls this handler.
 */
static void uarte_handler(nrfx_uarte_event_t const * p_event, void * p_context)
{
    nrfx_uarte_t * p_inst = p_context;
    if (p_event->type == NRFX_UARTE_EVT_TX_DONE)
    {
        k_sem_give(&tx_sem);
    }
    else if (p_event->type == NRFX_UARTE_EVT_RX_DONE)
    {
        k_sem_give(&rx_sem);
    }
}

/**
 * @brief Setup UART peripherial
 * 
 */
void uart_setup()
{
    nrfx_err_t status;
    (void)status;

    uarte_config.baudrate = NRF_UARTE_BAUDRATE_115200;
    uarte_config.p_context = &uarte_inst;
    uarte_config.skip_gpio_cfg = false;
    status = nrfx_uarte_init(&uarte_inst, &uarte_config, uarte_handler);
    nrf_gpio_cfg_input(uarte_config.pselrxd, NRF_GPIO_PIN_PULLUP);

    IRQ_CONNECT(NRFX_IRQ_NUMBER_GET(UARTE_INST), 0, UARTE_INST_HANDLER, NULL, 0);

    return;
}

/**
 * @brief Write buffer to COM port
 *
 * @param data pointer to data
 * @param data_length length of the data in uint8_t size
 * @return uint8_t returns checksum of sent data
 */
uint8_t calc_cksum(uint8_t* data, int data_length)
{
    uint8_t checksum = 0;

    for (int i = 0; i < data_length; i++) {
        checksum += data[i];
	}

    return checksum;
}

/**
 * @brief Write buffer accoring to BACA protocol
 *
 * @param data pointer to data
 * @param data_length length of the data in uint8_t size
 */
void write_baca(struct baca_protocol *msg)
{
    // write protocol header

    uint8_t out_buffer[256];

    out_buffer[0] = 'b';
    out_buffer[1] = msg->payload_size;
    memcpy(&out_buffer[2], msg->payload, msg->payload_size);

    out_buffer[2 + msg->payload_size] = calc_cksum(out_buffer, 2 + msg->payload_size);

    write_buffer(out_buffer, 2 + msg->payload_size + 1);
    return;
}

/**
 * @brief Read data into buffer
 * 
 * @param buffer pointer to received payload
 * @param buflen length of the buffer
 * @return int length of received data
 */
int read_baca(struct baca_protocol *msg)
{
    int status;

    msg->cksum = 0;
    msg->payload_size = 0;

    uint8_t c = '\0';

    while(c != 'b')
        c = read_char();

    msg->cksum = c;

    status = read_buffer(&msg->payload_size, sizeof(msg->payload_size), K_MSEC(10));

    if(status != 0)
        return -1;

    msg->cksum += msg->payload_size;

    if (msg->payload_size == 0 || msg->payload_size > 255)
        return -1;

    msg->payload = k_malloc(sizeof(uint8_t)*msg->payload_size);

    __ASSERT(msg->payload != NULL, "Failed allocating buffer of size %d Bytes!", msg->payload_size);

    status = read_buffer(msg->payload, msg->payload_size, K_MSEC(10));

    if(status != 0)
    {
        k_free(msg->payload);
        return -1;
    }

    msg->cksum += calc_cksum(msg->payload, msg->payload_size);

    uint8_t rx_cksum;
    status = read_buffer(&rx_cksum, sizeof(rx_cksum), K_MSEC(10));

    if(status != 0 || rx_cksum != msg->cksum)
    {
        k_free(msg->payload);
        return -1;
    }

    return msg->payload_size;
}

/**
 * @brief Write single character
 * 
 * @param c
 */
void write_char(uint8_t c)
{
    write_buffer(&c, 1);
    return;
}

/**
 * @brief Write buffer to UART
 * 
 * @param buffer pointer to buffer that needs to be written out
 * @param len length of the data
 */
void write_buffer(uint8_t *buffer, int len)
{
    k_sem_take(&tx_sem, K_FOREVER);
    int status = nrfx_uarte_tx(&uarte_inst, buffer, len);
    __ASSERT(status == NRFX_SUCCESS, "UARTE write fail!");

    status = k_sem_take(&tx_sem, K_MSEC(10));

    if(status != 0)
    {
        nrfx_uarte_tx_abort(&uarte_inst);
    }

    k_sem_give(&tx_sem);
    return;
}

/**
 * @brief Read single character
 * 
 * @return uint8_t character from UART
 */
uint8_t read_char()
{
    uint8_t c;

    read_buffer(&c, 1);

    return c;
}

/**
 * @brief Read bigger chunk of data to buffer
 * 
 * @param buf pointer to buffer
 * @param len length of the data to be received
 */
int read_buffer(uint8_t *buf, int len, k_timeout_t timeout)
{
    int status = nrfx_uarte_rx(&uarte_inst, buf, len);
    __ASSERT(status == NRFX_SUCCESS, "UARTE read failed!");

    status = k_sem_take(&rx_sem, timeout);

    return status;
}
```
